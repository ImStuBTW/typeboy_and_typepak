#include "typeboy.dtsi"

&default_transform {
    col-offset = <6>;
};

&kscan1 {
  col-gpios
      = <&shift_reg 5 (GPIO_ACTIVE_HIGH)>
      , <&shift_reg 4 (GPIO_ACTIVE_HIGH)>
      , <&shift_reg 3 (GPIO_ACTIVE_HIGH)>
      , <&shift_reg 2 (GPIO_ACTIVE_HIGH)>
      , <&shift_reg 1 (GPIO_ACTIVE_HIGH)>
      , <&shift_reg 0 (GPIO_ACTIVE_HIGH)>
      ;
};