## zmk-config/boards/shields/typeboy/Kconfig.defconfig
```kconfig
if SHIELD_TYPEBOY_LEFT

config ZMK_KEYBOARD_NAME
    default "TypeBoy"
    
config ZMK_SPLIT_ROLE_CENTRAL
    default y

endif

if SHIELD_TYPEBOY_LEFT || SHIELD_TYPEBOY_RIGHT

config ZMK_SPLIT
    default y

config ZMK_DISPLAY
	select LV_FONT_MONTSERRAT_28

if ZMK_DISPLAY

config SPI
	default y

config LS0XX
	default y

config ZMK_DISPLAY_INVERT
	default y

endif # ZMK_DISPLAY

endif
```

## zmk-config/boards/shields/typeboy/Kconfig.shield
```kconfig
config SHIELD_TYPEBOY_LEFT
	def_bool $(shields_list_contains,typeboy_left)
    select SPI

config SHIELD_TYPEBOY_RIGHT
	def_bool $(shields_list_contains,typeboy_right)
    select SPI
```

## zmk-config/boards/west.yml
```yaml
manifest:
  remotes:
    - name: zmkfirmware
      url-base: https://github.com/zmkfirmware
    - name: Nicell
      url-base: https://github.com/Nicell
  projects:
    - name: zmk
      remote: Nicell
      revision: nice-view-custom-screen
      import: app/west.yml
  self:
    path: config
```
